#include <SPI.h>                                                    //library for SPI
#include <RF24.h>                                                   //library for NRF24L01 Radio module
#include <Wire.h>                                                   //library for I2C
#include <Adafruit_GFX.h>                                           //library for Advanced OLED Graphics
#include <Adafruit_SSD1306.h>                                       //library for Using OLED



int SLIDE = 0;                                                      //Declaring SLIDE Variable
float LOWTEMP = 100;                                                //Declaring LOWTEMP Variable
float HIGHTEMP = -100;                                              //Declaring HIGHTEMP Variable


RF24 radio(9, 8);                                                   //CE, CSN                                            
const byte address[6] = "1Node";                                    //Declaring the adress the radio will use
Adafruit_SSD1306 display(128, 64, &Wire, -1);                       //give OLED the required info

struct SensorData {                                                 //create a data package for the radio module
  float TEMP;                                                       //create a floating point variable TEMP in the package
  float HUM;                                                        //create a floating point variable HUM in the package
  float UV;                                                         //create a floating point variable UV in the package

};
SensorData data;                                                    //create a instance of SensorData (data)
const unsigned char cactus [] PROGMEM = {                           //creating a bitmap  
	0x00, 0x00, 0x00, 0x00, 0x00, 0x00, 0x00, 0x00, 0x00, 0x00, 0x00, 0x00, 0x00, 0x00, 0x00, 0x00, 
	0x00, 0x00, 0x00, 0x00, 0x00, 0x00, 0x18, 0x00, 0x00, 0x00, 0x00, 0x00, 0x00, 0x00, 0x00, 0x00, 
	0x00, 0x00, 0x00, 0x00, 0x00, 0x00, 0x24, 0x00, 0x00, 0x00, 0x00, 0x00, 0x00, 0x00, 0x00, 0x00, 
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	0x00, 0x00, 0x00, 0x00, 0x00, 0x00, 0x00, 0x00, 0x00, 0x00, 0x00, 0x00, 0x00, 0x00, 0x00, 0x00
};
const unsigned char Rain1 [] PROGMEM = {                           //creating a bitmap
	0x00, 0x00, 0x00, 0x00, 0x00, 0x00, 0x00, 0x00, 0x00, 0x00, 0x00, 0x00, 0x00, 0x00, 0x00, 0x00, 
	0x00, 0x00, 0x00, 0x00, 0x00, 0x00, 0x00, 0x00, 0x00, 0x00, 0x00, 0x00, 0x00, 0x00, 0x00, 0x00, 
	0x00, 0x00, 0x00, 0x00, 0x00, 0x00, 0x00, 0x00, 0x00, 0x00, 0x00, 0x00, 0x00, 0x00, 0x00, 0x00, 
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	0x00, 0x00, 0x00, 0x00, 0x00, 0x00, 0x00, 0x00, 0x00, 0x00, 0x00, 0x00, 0x00, 0x00, 0x00, 0x00
};
const unsigned char Rain2 [] PROGMEM = {                           //creating a bitmap
	0x00, 0x00, 0x00, 0x00, 0x00, 0x00, 0x00, 0x00, 0x00, 0x00, 0x00, 0x00, 0x00, 0x00, 0x00, 0x00, 
	0x00, 0x00, 0x00, 0x00, 0x00, 0x00, 0x00, 0x00, 0x00, 0x00, 0x00, 0x00, 0x00, 0x00, 0x00, 0x00, 
	0x00, 0x00, 0x00, 0x00, 0x00, 0x00, 0x00, 0x00, 0x00, 0x00, 0x00, 0x00, 0x00, 0x00, 0x00, 0x00, 
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	0x00, 0x00, 0x00, 0x00, 0x00, 0x00, 0x00, 0x00, 0x00, 0x00, 0x00, 0x00, 0x00, 0x00, 0x00, 0x00
};
const unsigned char Rain3 [] PROGMEM = {                           //creating a bitmap
	0x00, 0x00, 0x00, 0x00, 0x00, 0x00, 0x00, 0x00, 0x00, 0x00, 0x00, 0x00, 0x00, 0x00, 0x00, 0x00, 
	0x00, 0x00, 0x00, 0x00, 0x00, 0x00, 0x00, 0x00, 0x00, 0x00, 0x00, 0x00, 0x00, 0x00, 0x00, 0x00, 
	0x00, 0x00, 0x00, 0x00, 0x00, 0x00, 0x00, 0x00, 0x00, 0x00, 0x00, 0x00, 0x00, 0x00, 0x00, 0x00, 
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	0x00, 0x00, 0x00, 0x00, 0x00, 0x00, 0x00, 0x00, 0x00, 0x00, 0x00, 0x00, 0x00, 0x00, 0x00, 0x00
};
const unsigned char FIRE [] PROGMEM = {                           //creating a bitmap
	0x00, 0x00, 0x00, 0x00, 0x00, 0x00, 0x00, 0x00, 0x00, 0x00, 0x00, 0x00, 0x00, 0x00, 0x00, 0x00, 
	0x00, 0x00, 0x00, 0x00, 0x00, 0x00, 0x00, 0x10, 0x00, 0x00, 0x00, 0x00, 0x00, 0x00, 0x00, 0x00, 
	0x00, 0x00, 0x00, 0x00, 0x38, 0x20, 0x00, 0x00, 0x00, 0x00, 0x00, 0x00, 0x00, 0x00, 0x00, 0x00, 
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	0xe0, 0x38, 0x00, 0x00, 0x00, 0x00, 0x00, 0x00, 0x00, 0x00, 0x00, 0x00, 0x00, 0x1f, 0xe0, 0x00
};
const unsigned char SUN [] PROGMEM = {                           //creating a bitmap
	0x00, 0x00, 0x00, 0x00, 0x00, 0x00, 0x00, 0x00, 0x00, 0x00, 0x00, 0x00, 0x00, 0x00, 0x00, 0x00, 
	0x00, 0x00, 0x00, 0x00, 0x00, 0x00, 0x00, 0x00, 0x00, 0x00, 0x00, 0x00, 0x00, 0x00, 0x00, 0x00, 
	0x00, 0x00, 0x00, 0x00, 0x00, 0x00, 0x00, 0x00, 0x00, 0x00, 0x00, 0x00, 0x00, 0x00, 0x00, 0x00, 
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	0x00, 0x00, 0x00, 0x00, 0x00, 0x00, 0x00, 0x00, 0x00, 0x00
};
const unsigned char ROOMTEMP [] PROGMEM = {                           //creating a bitmap
	0x00, 0x00, 0x00, 0x00, 0x00, 0x00, 0x00, 0x00, 0x00, 0x00, 0x00, 0x00, 0x00, 0x00, 0x00, 0x00, 
	0x00, 0x00, 0x00, 0x00, 0x00, 0x00, 0x01, 0xe7, 0x80, 0x00, 0x00, 0x00, 0x00, 0x00, 0x00, 0x00, 
	0x00, 0x00, 0x00, 0x0c, 0x00, 0x60, 0x00, 0x00, 0x00, 0x00, 0x00, 0x00, 0x00, 0x00, 0x00, 0x00, 
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	0x81, 0xc0, 0x00, 0x00, 0x00, 0x00, 0x00, 0x00, 0x00, 0x00, 0x00, 0x00, 0x00, 0x3c, 0x00, 0x00
};
const unsigned char ICE [] PROGMEM = {                           //creating a bitmap
	0x00, 0x00, 0x00, 0x00, 0x00, 0x00, 0x00, 0x00, 0x00, 0x00, 0x00, 0x30, 0x00, 0x00, 0x00, 0x00, 
	0x00, 0x00, 0x00, 0x00, 0x00, 0x00, 0x00, 0x3f, 0xff, 0xc0, 0x00, 0x00, 0x00, 0x00, 0x00, 0x00, 
	0x00, 0x00, 0x00, 0x00, 0x3f, 0xff, 0xc0, 0x00, 0x00, 0x00, 0x00, 0x00, 0x00, 0x00, 0x00, 0x00, 
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	0x00, 0x00, 0x00, 0x00, 0x00, 0x00, 0x00, 0x00, 0x00, 0x00, 0x00, 0x00, 0x00, 0x00, 0x00, 0x00
};
const unsigned char SNOWFLAKE[] PROGMEM = {                           //creating a bitmap
  0x00, 0x00, 0x00, 0x00, 0x00, 0x00, 0x00, 0x00, 0x00, 0x00, 0x60, 0x00, 0x00, 0x00, 0x00, 0x00,
  0x00, 0x00, 0x00, 0x00, 0x00, 0x00, 0x00, 0x90, 0x00, 0x00, 0x00, 0x00, 0x00, 0x00, 0x00, 0x00,
  0x00, 0x00, 0x00, 0x00, 0x90, 0x00, 0x00, 0x00, 0x00, 0x00, 0x00, 0x00, 0x00, 0x00, 0x00, 0x00,
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  0x90, 0x00, 0x00, 0x00, 0x00, 0x00, 0x00, 0x00, 0x00, 0x00, 0x00, 0x00, 0x00, 0x60, 0x00, 0x00
};
const unsigned char VERYHIGHUV[] PROGMEM = {                           //creating a bitmap
  0x00, 0x00, 0x00, 0x00, 0x00, 0x00, 0x00, 0x00, 0x00, 0x00, 0x00, 0x00, 0x00, 0x00, 0x00, 0x00,
  0x00, 0x00, 0x3f, 0xff, 0x80, 0x00, 0x00, 0x00, 0x00, 0x00, 0x00, 0x00, 0x00, 0x00, 0x03, 0xff,
  0xff, 0xfe, 0x00, 0x00, 0x00, 0x00, 0x00, 0x00, 0x00, 0x00, 0x00, 0x73, 0xff, 0xff, 0xff, 0xc0,
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  0x00, 0x00, 0x00, 0x00, 0x00, 0x00, 0x00, 0x00, 0x00, 0x00, 0x00, 0x00, 0x00, 0x00, 0x00, 0x00
};
const unsigned char HIGHUV[] PROGMEM = {                           //creating a bitmap
  0x00, 0x00, 0x00, 0x00, 0x00, 0x00, 0x00, 0x00, 0x00, 0x00, 0x00, 0x00, 0x00, 0x00, 0x00, 0x00,
  0x00, 0x00, 0x07, 0xfe, 0x00, 0x00, 0x00, 0x00, 0x00, 0x00, 0x00, 0x00, 0x00, 0x00, 0x03, 0xff,
  0xff, 0xf8, 0x00, 0x00, 0x00, 0x00, 0x00, 0x00, 0x00, 0x00, 0x00, 0x13, 0xff, 0xff, 0xff, 0x80,
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  0x00, 0x00, 0x00, 0x00, 0x00, 0x00, 0x00, 0x00, 0x00, 0x00, 0x00, 0x00, 0x00, 0x00, 0x00, 0x00
};
const unsigned char MEDIUMUV[] PROGMEM = {                           //creating a bitmap
  0x00, 0x00, 0x00, 0x00, 0x00, 0x00, 0x00, 0x00, 0x00, 0x00, 0x00, 0x00, 0x00, 0x00, 0x00, 0x00,
  0x00, 0x00, 0x00, 0x00, 0x00, 0x00, 0x00, 0x00, 0x00, 0x00, 0x00, 0x00, 0x00, 0x00, 0x00, 0x00,
  0x00, 0x00, 0x00, 0x00, 0x00, 0x00, 0x00, 0x00, 0x00, 0x00, 0x00, 0x00, 0x00, 0x00, 0x00, 0x00,
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  0x00, 0x00, 0x00, 0x00, 0x00, 0x00, 0x00, 0x00, 0x00, 0x00, 0x00, 0x00, 0x00, 0x00, 0x00, 0x00

};
const unsigned char LOWUV[] PROGMEM = {                           //creating a bitmap
  0x00, 0x00, 0x00, 0x00, 0x00, 0x00, 0x00, 0x00, 0x00, 0x00, 0x00, 0x00, 0x00, 0x00, 0x00, 0x00,
  0x00, 0x00, 0x00, 0x00, 0x00, 0x00, 0x00, 0x00, 0x00, 0x00, 0x00, 0x00, 0x00, 0x00, 0x00, 0x00,
  0x00, 0x00, 0x00, 0x00, 0x00, 0x00, 0x00, 0x00, 0x00, 0x00, 0x00, 0x00, 0x00, 0x00, 0x00, 0x00,
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  0x00, 0x00, 0x00, 0x00, 0x00, 0x00, 0x00, 0x00, 0x00, 0x00, 0x00, 0x00, 0x00, 0x00, 0x00, 0x00
};
const unsigned char VERYLOWUV[] PROGMEM = {                           //creating a bitmap
  0x00, 0x00, 0x00, 0x00, 0x00, 0x00, 0x00, 0x00, 0x00, 0x00, 0x00, 0x00, 0x00, 0x00, 0x00, 0x00,
  0x00, 0x00, 0x00, 0x00, 0x00, 0x00, 0x00, 0x00, 0x00, 0x00, 0x00, 0x00, 0x00, 0x00, 0x00, 0x00,
  0x00, 0x00, 0x00, 0x00, 0x00, 0x00, 0x00, 0x00, 0x00, 0x00, 0x00, 0x00, 0x01, 0xf0, 0x00, 0x00,
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  0x00, 0x00, 0x00, 0x00, 0x00, 0x00, 0x00, 0x00, 0x00, 0x00, 0x00, 0x00, 0x00, 0x00, 0x00, 0x00
};
void setup() {                                         
  
  radio.begin();                                                      //Start Radio up
  display.begin(SSD1306_SWITCHCAPVCC, 0x3C);                          //Start OLED up
   

  radio.begin();                                                     // Initialize RF24
  radio.openReadingPipe(1, address);                                 // Open pipe with address
  radio.setPALevel(RF24_PA_LOW);                                     // Set power level
  radio.setDataRate(RF24_1MBPS);                                     // Set data rate 
  radio.startListening();                                            // Declaring Radio as a Receiver

  pinMode(2, INPUT);                                                 // Declaring pin 2 as input
  attachInterrupt(digitalPinToInterrupt(2), Interrupt, FALLING);     // attaching a interrupt to pin 2 
}


void loop() {
  
  if (radio.available()) {                                           // Checking whether there is a radio message available 
    radio.read(&data, sizeof(data));                                 // If a radio messsage is available, then read it and 

    
    if (data.TEMP < LOWTEMP) {                                       // Changes the LOWTEMP to the lowest TEMP yet
      LOWTEMP = data.TEMP;                                           // ^^^^^^
    }
    if (data.TEMP > HIGHTEMP) {                                      // Changes the HIGHTEMP to the HIGHEST TEMP yet
      HIGHTEMP = data.TEMP;                                          // ^^^^^^
    }


    if (SLIDE == 0) {                                               // deciding which data to display ]
      TEMP(data);                                                   //                                ]
    } else if (SLIDE == 1) {                                        //                                ]
      HUM(data);                                                    //                                ]
    } else if (SLIDE == 2) {                                        //                                ]
      UV(data);                                                     //                                ]
    }



    
  
  }
}

void Interrupt(){                                                   // Interrupt function
  SLIDE = (SLIDE+1) % 3;                                            // Adds one to SLIDE until it hits 2 then it returns to 0 making a circle scroll
}

void TEMP(SensorData data) {                                        // Function that displays the required info for Temprature
  display.clearDisplay();                                           // Clears display
  display.setCursor(0, 0);                                          // Sets cursor to top left
  display.setTextSize(1);                                           // Set min text size
  display.setTextColor(WHITE);                                      // Set text color
  display.print("TEMP = ");                                         // Displaying data
  display.print(data.TEMP);                                         // Displaying data
  display.print((char)247);                                         // Degree symbol
  display.print("C       ");                                        // Displaying data
  display.print("HIGH = ");                                         // Displaying data
  display.print(HIGHTEMP);                                          // Displaying data
  display.print((char)247);                                         // Degree symbol
  display.print("C       ");                                        // Displaying data
  display.print("LOW  = ");                                         // Displaying data
  display.print(LOWTEMP);                                           // Displaying data
  display.print((char)247);                                         // Degree symbol
  display.println("C          ");                                   // Displaying data
  display.clearDisplay();                                           // Displaying data
  display.print("Feeling = ");                                      // Displaying data

  if (data.TEMP < 10.00) {
    display.print("FREEZING");                                      // Changing bitmap based on temp
    display.drawBitmap(30, 0, SNOWFLAKE, 100, 32, WHITE);           // Changing bitmap based on temp
  } else if (data.TEMP < 15.00) {                                   // Changing bitmap based on temp
    display.print("VERY COLD");                                     // Changing bitmap based on temp
    display.drawBitmap(30, 0, SNOWFLAKE, 100, 32, WHITE);           // Changing bitmap based on temp
  } else if (data.TEMP < 19.00) {                                   // Changing bitmap based on temp
    display.print("COLD");                                          // Changing bitmap based on temp
    display.drawBitmap(30, 0, SNOWFLAKE, 100, 32, WHITE);           // Changing bitmap based on temp
  } else if (data.TEMP < 26.00) {                                   // Changing bitmap based on temp
    display.print("ROOM TEMP");                                     // Changing bitmap based on temp
    display.drawBitmap(24, -1, ROOMTEMP, 100, 32, WHITE);           // Changing bitmap based on temp
  } else if (data.TEMP < 29.00) {                                   // Changing bitmap based on temp
    display.print("WARM");                                          // Changing bitmap based on temp
    display.drawBitmap(30, -5, SUN, 100, 50, WHITE);                // Changing bitmap based on temp
  } else if (data.TEMP < 34.00) {                                   // Changing bitmap based on temp
    display.print("HOT");                                           // Changing bitmap based on temp
   display.drawBitmap(30, -5, SUN, 100, 50, WHITE);                 // Changing bitmap based on temp
  } else if (data.TEMP > 34.01) {                                   // Changing bitmap based on temp
    display.print("VERY HOT");                                      // Changing bitmap based on temp
    display.drawBitmap(24, -1, SUN, 100, 32, WHITE);                // Changing bitmap based on temp
  }
  
  
  display.display();                                                // Sending all display functions on the bufffer to the screen
}
void HUM(SensorData data) {                                         // Function that displays the required info for Humidity
  display.clearDisplay();                                           // Clears display
  display.setCursor(0, 0);                                          // Sets cursor to top left
  display.setTextSize(1);                                           // Set min text size
  display.setTextColor(WHITE);                                      // Set text color
  display.print("Humidity = ");                                     // Displaying data
  display.print(data.HUM);                                          // Displaying data
  display.print("%    ");                                           // Displaying data

  
  if(data.HUM<20.00){                                               // Changing bitmap based on HUM
    display.print("Dry");                                           // Changing bitmap based on HUM
    display.drawBitmap(0, 30, cactus, 128, 32, WHITE);              // Changing bitmap based on HUM
  }
  else if (data.HUM<50){                                            // Changing bitmap based on HUM
    display.print("Comfortable");                                   // Changing bitmap based on HUM
    display.drawBitmap(0, 30, Rain1, 128, 32, WHITE);               // Changing bitmap based on HUM
  }
  else if (data.HUM<70){                                            // Changing bitmap based on HUM
    display.print("Humid");                                         // Changing bitmap based on HUM
    display.drawBitmap(0, 30, Rain2, 128, 32, WHITE);               // Changing bitmap based on HUM
  }
  else if (data.HUM>70){                                            // Changing bitmap based on HUM
    display.print("Very Humid");                                    // Changing bitmap based on HUM
    display.drawBitmap(0, 30, Rain3, 128, 32, WHITE);               // Changing bitmap based on HUM
  }

  display.display();                                                // Sending all display functions on the bufffer to the screen
}
void UV(SensorData data) {                                          // Function that displays the required info for UV
   display.clearDisplay();                                          // Clears display
  display.setCursor(0, 0);                                          // Sets cursor to top left
  display.setTextSize(1);                                           // Set min text size
  display.setTextColor(WHITE);                                      // Set text color
  display.print("UV = ");                                           // Displaying data
  display.print(data.UV);                                           // Displaying data

  if (data.UV < 2) {                                                // Changing bitmap based on UV
    display.drawBitmap(20, 15, VERYLOWUV, 100, 64, WHITE);          // Changing bitmap based on UV
    
  } else if (data.UV < 4) {                                         // Changing bitmap based on UV
    display.drawBitmap(20, 15, LOWUV, 100, 64, WHITE);              // Changing bitmap based on UV
    
  } else if (data.UV < 6) {                                         // Changing bitmap based on UV
    display.drawBitmap(20, 15, MEDIUMUV, 100, 64, WHITE);           // Changing bitmap based on UV
   
  } else if (data.UV < 8) {                                         // Changing bitmap based on UV
    display.drawBitmap(20, 15, HIGHUV, 100, 64, WHITE);             // Changing bitmap based on UV
   
  } else if (data.UV < 11) {                                        // Changing bitmap based on UV
    display.drawBitmap(20, 15, VERYHIGHUV, 100, 64, WHITE);         // Changing bitmap based on UV
    
  }
  
  display.display();                                                // Sending all display functions on the bufffer to the screen
}
